// TEMPLATE FOR CMAKE AUTOMATIC GENERATOR
// This file will be automatically populated depending on examples
// defined in LIBTROPIC_EXAMPLE_LIST.

#ifdef LT_BUILD_EXAMPLES
  int __lt_ex_return_val__;

  #ifdef LT_CMAKE_DUMMY_EXAMPLE // This does nothing, only a dummy first branch for following elifs generated by CMake.
  #elif defined(LT_EX_SHOW_CHIP_ID_AND_FWVER)
__lt_ex_return_val__ = lt_ex_show_chip_id_and_fwver(__lt_handle__);
#elif defined(LT_EX_HELLO_WORLD_SEPARATE_API)
__lt_ex_return_val__ = lt_ex_hello_world_separate_API(__lt_handle__);
#elif defined(LT_EX_HELLO_WORLD)
__lt_ex_return_val__ = lt_ex_hello_world(__lt_handle__);
#elif defined(LT_EX_HARDWARE_WALLET)
__lt_ex_return_val__ = lt_ex_hardware_wallet(__lt_handle__);
#elif defined(LT_EX_MACANDD)
__lt_ex_return_val__ = lt_ex_macandd(__lt_handle__);
#elif defined(LT_EX_FW_UPDATE)
__lt_ex_return_val__ = lt_ex_fw_update(__lt_handle__);

  #else
    #error "No example selected! Check if macros are correctly defined."
  #endif
#endif
