// TEMPLATE FOR CMAKE AUTOMATIC GENERATOR
// This file will be automatically populated depending on tests
// defined in LIBTROPIC_TEST_LIST.

#ifdef LT_BUILD_TESTS
  #ifdef LT_CMAKE_DUMMY_TEST // This does nothing, only a dummy first branch for following elifs generated by CMake.
  #elif defined(LT_TEST_REV_ECDSA_SIGN)
  lt_test_rev_ecdsa_sign(&__lt_handle__);
#elif defined(LT_TEST_REV_EDDSA_SIGN)
  lt_test_rev_eddsa_sign(&__lt_handle__);
#elif defined(LT_TEST_IRE_PAIRING_KEY_SLOTS)
  lt_test_ire_pairing_key_slots(&__lt_handle__);
#elif defined(LT_TEST_IRE_WRITE_I_CONFIG)
  lt_test_ire_write_i_config(&__lt_handle__);
#elif defined(LT_TEST_REV_PING)
  lt_test_rev_ping(&__lt_handle__);
#elif defined(LT_TEST_REV_R_MEM)
  lt_test_rev_r_mem(&__lt_handle__);
#elif defined(LT_TEST_REV_ERASE_R_CONFIG)
  lt_test_rev_erase_r_config(&__lt_handle__);
#elif defined(LT_TEST_REV_HANDSHAKE_REQ)
  lt_test_rev_handshake_req(&__lt_handle__);
#elif defined(LT_TEST_REV_MCOUNTER)
  lt_test_rev_mcounter(&__lt_handle__);
#elif defined(LT_TEST_REV_GET_INFO_REQ_APP)
  lt_test_rev_get_info_req_app(&__lt_handle__);
#elif defined(LT_TEST_REV_GET_INFO_REQ_BOOTLOADER)
  lt_test_rev_get_info_req_bootloader(&__lt_handle__);
#elif defined(LT_TEST_REV_READ_I_CONFIG)
  lt_test_rev_read_i_config(&__lt_handle__);
#elif defined(LT_TEST_REV_READ_R_CONFIG)
  lt_test_rev_read_r_config(&__lt_handle__);
#elif defined(LT_TEST_REV_RESEND_REQ)
  lt_test_rev_resend_req(&__lt_handle__);
#elif defined(LT_TEST_REV_SLEEP_REQ)
  lt_test_rev_sleep_req(&__lt_handle__);
#elif defined(LT_TEST_REV_STARTUP_REQ)
  lt_test_rev_startup_req(&__lt_handle__);
#elif defined(LT_TEST_REV_WRITE_R_CONFIG)
  lt_test_rev_write_r_config(&__lt_handle__);
#elif defined(LT_TEST_REV_ECC_KEY_GENERATE)
  lt_test_rev_ecc_key_generate(&__lt_handle__);
#elif defined(LT_TEST_REV_ECC_KEY_STORE)
  lt_test_rev_ecc_key_store(&__lt_handle__);
#elif defined(LT_TEST_REV_RANDOM_VALUE_GET)
  lt_test_rev_random_value_get(&__lt_handle__);
#elif defined(LT_TEST_REV_MAC_AND_DESTROY)
  lt_test_rev_mac_and_destroy(&__lt_handle__);
#elif defined(LT_TEST_REV_GET_LOG_REQ)
  lt_test_rev_get_log_req(&__lt_handle__);

  #else
    #error "No test selected! Check if macros are correctly defined."
  #endif
#endif
